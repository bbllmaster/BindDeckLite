## bl_idf/sdkconfig.defaults
```kconfig
CONFIG_SPI_FLASH_ROM_IMPL=y
CONFIG_ESPTOOLPY_FLASHSIZE_16MB=y
CONFIG_ESPTOOLPY_FLASHSIZE="16MB"
CONFIG_ESPTOOLPY_FLASHMODE_DIO=y
CONFIG_ESPTOOLPY_FLASHFREQ_40M=y
CONFIG_BOOTLOADER_LOG_LEVEL_NONE=y
CONFIG_PARTITION_TABLE_OFFSET=0x8000
```
